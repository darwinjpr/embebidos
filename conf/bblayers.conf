## conf/bblayers.conf
```bitbake
# POKY_BBLAYERS_CONF_VERSION is increased each time build/conf/bblayers.conf
# changes incompatibly
POKY_BBLAYERS_CONF_VERSION = "2"

BBPATH = "${TOPDIR}"
BBFILES ?= ""

BBLAYERS ?= " \
  /home/edov84/Documentos/TEC/Semestre1_2020/Taller_Sistemas_Embebidos/poky-warrior/meta \
  /home/edov84/Documentos/TEC/Semestre1_2020/Taller_Sistemas_Embebidos/poky-warrior/meta-poky \
  /home/edov84/Documentos/TEC/Semestre1_2020/Taller_Sistemas_Embebidos/poky-warrior/meta-raspberrypi \
  /home/edov84/Documentos/TEC/Semestre1_2020/Taller_Sistemas_Embebidos/poky-warrior/meta-py \
  /home/edov84/Documentos/TEC/Semestre1_2020/Taller_Sistemas_Embebidos/poky-warrior/meta-openembedded/meta-oe \
  /home/edov84/Documentos/TEC/Semestre1_2020/Taller_Sistemas_Embebidos/poky-warrior/meta-openembedded/meta-python \
  /home/edov84/Documentos/TEC/Semestre1_2020/Taller_Sistemas_Embebidos/poky-warrior/meta-openembedded/meta-gstreamer1.0 \
  "
```

## meta-demo/conf/layer.conf
```bitbake
# We have a conf and classes directory, add to BBPATH
BBPATH .= ":${LAYERDIR}"

# We have recipes-* directories, add to BBFILES
BBFILES += "${LAYERDIR}/recipes-*/*.bb \
            ${LAYERDIR}/recipes-*/*/*.bbappend"

BBFILE_COLLECTIONS += "demo"
BBFILE_PATTERN_demo = "^${LAYERDIR}/"
BBFILE_PRIORITY_demo = "5"
LAYERVERSION_demo = "4"
LAYERSERIES_COMPAT_demo = "warrior"
```
